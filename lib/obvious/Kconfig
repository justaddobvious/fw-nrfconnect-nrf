## lib/obvious/Kconfig
```kconfig
#######################################################################
##
##            @@@
##            @@@
##   @@@@@@@  @@@@@@@@  @@   @@@ @@   @@@@@@@  @@@   @@  @@@@@@@
##  @@    @@@ @@@   @@@  @@  @@  @@  @@    @@@ @@@   @@  @@@@
##  @@    @@@ @@@   @@@  @@@@@   @@  @@    @@@ @@@   @@      @@@
##   @@@@@@@  @@@@@@@@    @@@    @@   @@@@@@@   @@@@@@@  @@@@@@@  @@
##
##                                                      -smMMm/         
##    `odmhs.                                         :hMMMMMNN/        
##   `hMMMMMNy/`                                    +mMMMMMMNmdy        
##   -NMMMMMMMNms.                                oNMMMMMMMMNdyh-       
##   +MNMMMMMMMMMMd/`                          -sNMNMMMMMNNNmhsds       
##   yNmMMMMMMMMMMNmmy-                      -sNNmNMMMNNNmhyo+sdy       
##   sMNNMMMMMMMMMNNmmNh/-....//::./+oooossydmmsodmmmNMMNNmdyoydh       
##   /MNdmmMMMMMMNNmdyyhdmdmNNNNNNNMNNNMNMNdmm++oyddmNNNNmdyso+yh.      
##   `Nmmhhddddmmmmdhs++ydmhhdmNMNNMNMmMdNmdddhdhydmmmddmNmdyssmd.      
##   `NmhhmNMMMNmNNmdyyshmNddmmddNmNNNmNdhmhhhmNmdhyyyyoo/:+syddo-
##   `mMMmdmdhyyyyyyhmNNNNmmmddhhNdNmmMNNmdhddmmNmyo+///-.-:++dNmo
##   :NMMdss+::/:.`-oymMMMNmdhhdmMNNNNMNMMmmmmdmNMMNdhhs/::++ohmMd-    
##   :MMNyyoo/:soooydMMMMNmddhmMNNMMMNMMNNMNdhdmmmNMMMMNdhs+/ohddmy    
##  .mMMNdyo++ohNNMMMMMNmmddhdNMMNNMNNMMNMMMmmNMNdmNmNNMMMmhyddhhhh-    
##  :NNNmmmhydMMMMMMNNNNNNMMNNMMMMNNddNNMMMMNNMMMMNNmddmNMMMMNmhhys
##  :NNNNNNMMMMMMMNNNNNMMMMMMNMMMNNNdydmNmNNmmhyhmMMNmdhhdmNNdhysy/
##  .mmdmNMMMMMNNNNNMMMNhyo++shddhyyssyhhyyy/`  ``.+yddyyyyhdmmhsy:
##   yNmmNMMMNNNNmNNmy+`-.    .syhysyosyydd/-`  `. -+/+shhyhhddys+.
##   -ddhmNMMNNNNmhsydm/--`  `.`yNmdhyyhhms ::.`.:odmmds:+hddhhy/
##    .odmNMMMNmdsdNMMMMmysooso:-ymmmmNmhs`-hddmNNNNNmmdo.:shhyo.
##     `oNNMNmhh/smNMMMMMMMMMMMm++hdMMMNh+-odNNNNNmNNNNNmy-+syy:
##      `sNNmhs+/dMMMMMNNNNNNNNdyo/dMMMMh::shhhhdmmmmddmdh::oo+
##       `/ddo-:omMMNmmmddNNNmmmmhoo+yy+:-ydddhhdddddhhdmds:oy.
##        -mMNmdmNMMNmddmNMmddNNNNh-  ` `+NNmdyydNNmmdddmmmmmh-
##        -mMMMMMMMMNmmNNMMNNMMNMMMMh:`:dNNNNNNNMMNNNNNNNNNNNy.
##        .yMMMMMMMMMMNNNNMMMMMMNNmhs:`:ohmmNNNMMMNNNNNMMMMNNo-
##         .sNMMMMMMMMMMNNNMMMMMNdyo-.`.:+shmNNNNNNNNNNNNNNNNd:.
##         .:dMMMMMMMMMNNNNNNNNNmdhhhysyhddmmmmmmmmNNNNmdddmmNy:
##         -+nMMMMMMMMNNNmmNmmmdmmmmmmmmmmdhhhhddmmddhhhhhdmmNm+:
##         .sMMMMMMNMMNNmmmmmmmdddddddhhhhyyyyyyyyyyyyyyyyydmmm/`
##          yMMMMMMNNNNmmmmmmddddhhhhhhhhhhssssso+syyyhhhddhddm+  
##         .dMMMMMMNNNNmmNmdmddhddddhhhhhhhhysyyys+oyyhhddmdddms`  
##        -/NMMMMMMMMNNNmdhhddhhhhdddhhhhhhyyssyyyyosyyhdmmmddmm:       
##        `/MMMMMMMMNNNNmhyshyyhhdmmdoshdhyyyssyyyhyyhhddddddddds.    
##
#######################################################################


menu "Obvious - Embedded Device Management Platform"

config OBVIOUS
         bool "Obvious - Embedded device mangement platform"
         select BSD_LIBRARY
         select FLASH
         select FLASH_MAP
         select FLASH_PAGE_LAYOUT
         select MODEM_KEY_MGMT
         select MPU_ALLOW_FLASH_WRITE
         select MQTT_LIB
         select MQTT_LIB_TLS
         select REBOOT
         depends on HEAP_MEM_POOL_SIZE >= 1024
         depends on LTE_LINK_CONTROL && !LTE_AUTO_INIT_AND_CONNECT
         depends on NETWORKING && !NET_NATIVE
         default n
         help
            This option enables the Obvious embedded device management platform.
            This Obvious platform allows you to manage features firmware on an
            embedded device. The obvious platform utilises the zephyr MQTT library
            and the NCS modules for performing AWS FOTA.

if (OBVIOUS)

config OBVIOUS_FOTA
         bool "Include FOTA handled by Obvious"
         select AWS_FOTA
         select BOOTLOADER_MCUBOOT
         select DFU_TARGET
         select DFU_TARGET_MCUBOOT
         select DFU_TARGET_MCUBOOT_SAVE_PROGRESS
         select DFU_TARGET_MODEM
         select DOWNLOAD_CLIENT
         select DOWNLOAD_CLIENT_TLS
         select FOTA_DOWNLOAD
         select IMG_ERASE_PROGRESSIVELY
         select IMG_MANAGER
         select NVS
         select SETTINGS
         default n
         help
            This option enables AWS Fota, MCUBoot, and DFU Target, Image Manager,
            and Settings to support Firmware over the air handled my Obvious.

module = OBVIOUS
module-dep = LOG
module-str = OBVIOUS - Embedded device management platform
source"${ZEPHYR_BASE}/subsys/logging/Kconfig.template.log_config"

endif # OBVIOUS

endmenu
```
